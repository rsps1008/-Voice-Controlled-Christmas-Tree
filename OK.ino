#include <Wire.h>
#include <SeeedGrayOLED.h>
#include <avr/pgmspace.h>
#include <math.h>
#include <ChainableLED.h>
static const unsigned char SeeedLogo[] PROGMEM = 
{
0x00,0x00,0x00,0x00,0x00,0x17,0xE0,0x00,0x00,0x00,0x00,0x00,0x00,0x00,0x00,0x00,
0x00,0x0F,0xF0,0x00,0x00,0x00,0x00,0x00,0x00,0x00,0x00,0x00,0x00,0x0F,0xF0,0x00,
0x00,0x00,0x00,0x00,0x00,0x00,0x00,0x00,0x00,0x2F,0xF8,0x00,0x00,0x00,0x00,0x00,
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0x00,0x00,0x00,0x00,0x00,0x00,0x00,0x00,0x00,0x00,0x00,0x00,0x00,0x00,0x00,0x00
};

void setup()
{
  Serial.begin(9600);
  Wire.begin();
  SeeedGrayOled.init(SSD1327);             //initialize SEEED OLED display
  SeeedGrayOled.clearDisplay();     //Clear Display.
  SeeedGrayOled.setNormalDisplay(); //Set Normal Display Mode
  SeeedGrayOled.setVerticalMode();  // Set to vertical mode for displaying text
  SeeedGrayOled.setTextXY(5,4);  //set Cursor to ith line, 0th column
  SeeedGrayOled.setGrayLevel(15); //Set Grayscale level. Any number between 0 - 15.
  SeeedGrayOled.putString("Merry"); //Print Hello World
  SeeedGrayOled.setTextXY(6,2);  //set Cursor to ith line, 0th column
  SeeedGrayOled.setGrayLevel(15); //Set Grayscale level. Any number between 0 - 15.
  SeeedGrayOled.putString("Chritmas!"); //Print Hello World
}

void loop()
{
  Serial.println("ready");
  if(Serial.available()>0){
    Serial.println("read00");
    int A = Serial.read();
    Serial.println(A);
    if (A == 48){
      //Serial.println("0");
      int a = analogRead(A0);
      float R = 1023.0/a-1.0; R = 100000*R;
      int temperature = (1.0/(log(R/100000)/4275+1/298.15)-273.15)*100;
      int TEMP1 = temperature/100; int TEMP2 = temperature%100; 
      char temp1[5], temp2[5], dot[]=".", unit[]=" C", temmp[]="Temp:";
      sprintf(temp1,"%d",TEMP1); sprintf(temp2,"%d",TEMP2);
      strcat(temmp,temp1);strcat(temmp,dot); strcat(temmp,temp2); strcat(temmp,unit);
      SeeedGrayOled.setTextXY(8,0);  //set Cursor to ith line, 0th column
      SeeedGrayOled.setGrayLevel(15); //Set Grayscale level. Any number between 0 - 15.
      SeeedGrayOled.putString(temmp); //Print Hello World
      delay(3000);
      SeeedGrayOled.setTextXY(8,0);  //set Cursor to ith line, 0th column
      SeeedGrayOled.setGrayLevel(15); //Set Grayscale level. Any number between 0 - 15.
      SeeedGrayOled.putString("            "); //Print Hello World
    }
    else if (A == 50){
      SeeedGrayOled.setTextXY(8,4);  //set Cursor to ith line, 0th column
      SeeedGrayOled.setGrayLevel(15); //Set Grayscale level. Any number between 0 - 15.
      SeeedGrayOled.putString("REC..."); //Print Hello World
    }
    else if (A == 51){
      SeeedGrayOled.setTextXY(8,0);  //set Cursor to ith line, 0th column
      SeeedGrayOled.setGrayLevel(15); //Set Grayscale level. Any number between 0 - 15.
      SeeedGrayOled.putString("            "); //Print Hello World
    }
    else if (A == 52){
      /*for(int z=0;z<12;z++){
          SeeedGrayOled.setTextXY(z,0);
          SeeedGrayOled.clearDisplay();
          SeeedGrayOled.putString("            ");
      }*/
      SeeedGrayOled.clearDisplay();    
      SeeedGrayOled.drawBitmap(SeeedLogo,96*96);
      delay(3000);
      /*for(int z=0;z<12;z++){
          SeeedGrayOled.setTextXY(z,0);
          SeeedGrayOled.clearDisplay();
          SeeedGrayOled.putString("            ");
      }*/
      delay(3000);
      SeeedGrayOled.setTextXY(5,4);  //set Cursor to ith line, 0th column
      SeeedGrayOled.setGrayLevel(15); //Set Grayscale level. Any number between 0 - 15.
      SeeedGrayOled.putString("Merry"); //Print Hello World
      SeeedGrayOled.setTextXY(6,2);  //set Cursor to ith line, 0th column
      SeeedGrayOled.setGrayLevel(15); //Set Grayscale level. Any number between 0 - 15.
      SeeedGrayOled.putString("Chritmas!"); //Print Hello World
    }
    else if (A == 49){
      if (Serial.available() > 0){
        String d = Serial.readString();
        char t[50];
        strcpy(t, d.c_str());
        char *s = strtok(t, " ");
        char *put[100]; int s_count=0;
        while(s != NULL) {
          put[s_count++]=s;
          s = strtok(NULL, " ");
        }
        int i = (10 - s_count) / 2 + 1;
        for(int z=0;z<12;z++){
          SeeedGrayOled.setTextXY(z,0);
          SeeedGrayOled.putString("            ");
        }
        for(int j=0;j<s_count;j++){
          int k = (10 - strlen(put[j])) / 2 + 2;
          SeeedGrayOled.setTextXY(i,k);  //set Cursor to ith line, 0th column
          SeeedGrayOled.setGrayLevel(15); //Set Grayscale level. Any number between 0 - 15.
          SeeedGrayOled.putString(put[j]); //Print Hello World
          i++;
         }
         delay(3000);
         for(int z=0;z<12;z++){
          SeeedGrayOled.setTextXY(z,0);
          SeeedGrayOled.putString("            ");
        }
        SeeedGrayOled.setTextXY(5,4);  //set Cursor to ith line, 0th column
        SeeedGrayOled.setGrayLevel(15); //Set Grayscale level. Any number between 0 - 15.
        SeeedGrayOled.putString("Merry"); //Print Hello World
        SeeedGrayOled.setTextXY(6,2);  //set Cursor to ith line, 0th column
        SeeedGrayOled.setGrayLevel(15); //Set Grayscale level. Any number between 0 - 15.
        SeeedGrayOled.putString("Chritmas!"); //Print Hello World
      }
    }

    if(A==52) {
      
      }
  }
}


